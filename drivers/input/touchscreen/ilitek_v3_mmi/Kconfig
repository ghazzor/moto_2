## drivers/input/touchscreen/ilitek_v3_mmi/Kconfig
```kconfig
#
# Focaltech Touchscreen driver configuration
#

config TOUCHSCREEN_ILITEK_CHIPSET
	tristate "Moto ILITEK Touchscreen"
	depends on I2C
	default n
	help
	  Say Y here if you have Moto ILITEK touch panel.
	  If unsure, say N.
```

## drivers/misc/ldo_vibrator_mmi/Kconfig
```kconfig
config LDO_VIBRATOR_MMI
	tristate "LDO VIBRATOR MMI"
	help
	  Say Y here if you have LDO VIBRATOR MMI
	  defined in your system.

	  If unsure, say N.

	  To compile this driver as a module, choose M here: the
	  module will be called ldo_vibrator_mmi.
```
